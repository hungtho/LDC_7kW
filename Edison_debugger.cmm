
  SYStem.RESet
  
  SYStem.CPU TC234LP

;reset processor and connect
  SYStem.UP
FLASH.RESet

; Program flash PF0
FLASH.Create 1. 0xA0000000--0xA000BFFF  0x4000 TARGET Long /BootModeHeaDer 0xA0000000--0xA000001F  ; PS0, S0..S2
FLASH.Create 1. 0xA000C000--0xA0013FFF  0x4000 TARGET Long /BootModeHeaDer 0xA000FFE0--0xA000FFFF  ; PS0, S3..S4
FLASH.Create 1. 0xA0014000--0xA0017FFF  0x4000 NOP    Long /INFO "Tuning Protection"               ; PS0, S5
FLASH.Create 1. 0xA0018000--0xA001BFFF  0x4000 NOP    Long /INFO "HSM code sector"                 ; PS0, S6
FLASH.Create 1. 0xA001C000--0xA001FFFF  0x4000 TARGET Long /BootModeHeaDer 0xA001FFE0--0xA001FFFF  ; PS0, S7
FLASH.Create 1. 0xA0020000--0xA005FFFF  0x8000 TARGET Long /BootModeHeaDer 0xA0020000--0xA002001F  ; PS0, S8..S15
FLASH.Create 1. 0xA0060000--0xA007FFFF 0x10000 NOP    Long /INFO "HSM code sector"                 ; PS0, S16..S17
FLASH.Create 2. 0xA0080000--0xA009FFFF 0x10000 TARGET Long   ; PS1, S18..S19
FLASH.Create 2. 0xA00A0000--0xA00FFFFF 0x20000 TARGET Long   ; PS1, S20..S22
FLASH.Create 3. 0xA0100000--0xA017FFFF 0x40000 TARGET Long   ; PS2, S23..S24
FLASH.Create 4. 0xA0180000--0xA01FFFFF 0x40000 TARGET Long   ; PS3, S25..S26

; Data flash DF0
FLASH.Create 5. 0xAF000000--0xAF01FFFF  0x2000 TARGET Long /INFO "EEPROM"          ; DF0, EEPROM0..EEPROM15
FLASH.Create 6. 0xAF100000--0xAF1003FF   0x400 NOP    Long /INFO "UCB_PFlash"      ; DF0, UCB0
FLASH.Create 6. 0xAF100400--0xAF1007FF   0x400 NOP    Long /INFO "UCB_DFlash"      ; DF0, UCB1
FLASH.Create 6. 0xAF100800--0xAF100BFF   0x400 NOP    Long /INFO "UCB_HSMCOTP"     ; DF0, UCB2
FLASH.Create 6. 0xAF100C00--0xAF100FFF   0x400 NOP    Long /INFO "UCB_OTP"         ; DF0, UCB3
FLASH.Create 6. 0xAF101000--0xAF1013FF   0x400 NOP    Long /INFO "UCB_IFX"         ; DF0, UCB4
FLASH.Create 6. 0xAF101400--0xAF1017FF   0x400 NOP    Long /INFO "UCB_DBG"         ; DF0, UCB5
FLASH.Create 6. 0xAF101800--0xAF101BFF   0x400 NOP    Long /INFO "UCB_HSM"         ; DF0, UCB6
FLASH.Create 6. 0xAF101C00--0xAF101FFF   0x400 NOP    Long /INFO "UCB_HSMCFG"      ; DF0, UCB7
FLASH.Create 6. 0xAF102000--0xAF102FFF   0x400 NOP    Long                         ; DF0, UCB8..UCB11
FLASH.Create 6. 0xAF103000--0xAF103FFF   0x400 NOP    Long /INFO "Erase Counter"   ; DF0, UCB12..UCB15

; Cached program flash address range
FLASH.CreateALIAS 0x80000000--0x80FFFFFF 0xA0000000

  FLASH.TARGET 0xC0000000 0xD0000000 0x2000 ~~/demo/tricore/flash/long/tc2.bin

  FLASH.ReProgram.ALL /Erase

  DATA.LOAD.ELF ~~~~/2_Out/Tricore_Gnuc/Edison_tc.elf
  FLASH.ReProgram.off

;execute until function main

;set debug mode to HLL debugging
  MODE.HLL
  
  ;Go core0_main
  ;WAIT !STATE.RUN()
  
  Do ~~~~/Window.cmm

ENDDO // End of the script


